## board/pitlab/wallet/wallet_defconfig
```kconfig
# Core system settings
BR2_arm=y
BR2_cortex_a72=y
BR2_ARM_FPU_NEON_VFPV4=y

# Required for RPi4 and LCD35
BR2_TOOLCHAIN_BUILDROOT_CXX=y
BR2_PACKAGE_HOST_LINUX_HEADERS_CUSTOM_5_15=y
BR2_TOOLCHAIN_BUILDROOT_GLIBC=y

# System configuration
BR2_ROOTFS_DEVICE_TABLE="system/device_table.txt"
BR2_ROOTFS_OVERLAY="$(BR2_EXTERNAL_PITLAB_PATH)/board/pitlab/wallet/rootfs-overlay"
BR2_ROOTFS_POST_BUILD_SCRIPT="board/pitlab/wallet/post-build.sh"
BR2_ROOTFS_POST_IMAGE_SCRIPT="board/pitlab/wallet/post-image.sh"

# Linux kernel
BR2_LINUX_KERNEL=y
BR2_LINUX_KERNEL_CUSTOM_TARBALL=y
BR2_LINUX_KERNEL_CUSTOM_TARBALL_LOCATION="$(call github,raspberrypi,linux,5.15.y)/linux-5.15.y.tar.gz"
BR2_LINUX_KERNEL_DEFCONFIG="bcm2711"
BR2_LINUX_KERNEL_DTS_SUPPORT=y
BR2_LINUX_KERNEL_INTREE_DTS_NAME="bcm2711-rpi-4-b"
BR2_LINUX_KERNEL_NEEDS_HOST_OPENSSL=y

# Required for LCD35 display
BR2_PACKAGE_FBCP=y
BR2_PACKAGE_RPI_FIRMWARE=y
BR2_PACKAGE_RPI_FIRMWARE_DT_OVERLAYS=y
BR2_PACKAGE_FBSET=y
BR2_PACKAGE_FBGRAB=y
BR2_PACKAGE_UDEV=y
BR2_PACKAGE_UDEV_RULES_GEN=y
BR2_PACKAGE_EVTEST=y
BR2_PACKAGE_TSLIB=y

# Filesystem / image
BR2_TARGET_GENERIC_HOSTNAME="pitlab-wallet"
BR2_TARGET_GENERIC_ISSUE="Welcome to PitLab Wallet"
BR2_TARGET_ROOTFS_EXT2=y
BR2_TARGET_ROOTFS_EXT2_4=y
BR2_TARGET_ROOTFS_EXT2_SIZE="512M"
BR2_PACKAGE_HOST_DOSFSTOOLS=y
BR2_PACKAGE_HOST_GENIMAGE=y
BR2_PACKAGE_HOST_MTOOLS=y
```

## br2-external/Config.in
```kconfig
# PitLab Wallet external package configuration

menuconfig BR2_PACKAGE_PITLAB_WALLET
    bool "PitLab Wallet Packages"
    help
      Select PitLab Wallet specific packages

if BR2_PACKAGE_PITLAB_WALLET

menu "Display Support"
    source "$BR2_EXTERNAL_PITLAB_WALLET_PATH/package/rpi-fbcp/Config.in"
endmenu

menu "Hardware Security"
    source "$BR2_EXTERNAL_PITLAB_WALLET_PATH/package/trezord-go/Config.in"
    source "$BR2_EXTERNAL_PITLAB_WALLET_PATH/package/trezor-emu/Config.in"
endmenu

endif # BR2_PACKAGE_PITLAB_WALLET
```

## br2-external/configs/pi-trezor-pi5_defconfig
```kconfig
# Pi-Trezor Raspberry Pi 5 Configuration (64-bit)
# Air-gapped wallet appliance with Trezor Core and trezord-go
# Target: ARM64 (aarch64)

# Base Raspberry Pi 5 64-bit configuration
BR2_aarch64=y
BR2_cortex_a76=y

# System
BR2_SYSTEM_DHCP=""
BR2_TARGET_GENERIC_HOSTNAME="pi-trezor"
BR2_TARGET_GENERIC_ISSUE="Pi-Trezor Air-Gapped Wallet"
BR2_TARGET_GENERIC_PASSWD_SHA256=y
BR2_SYSTEM_BIN_SH_BASH=y

# Toolchain
BR2_PACKAGE_HOST_LINUX_HEADERS_CUSTOM_6_6=y
BR2_TOOLCHAIN_BUILDROOT_GLIBC=y
BR2_TOOLCHAIN_BUILDROOT_CXX=y

# Kernel
BR2_LINUX_KERNEL=y
BR2_LINUX_KERNEL_CUSTOM_TARBALL=y
BR2_LINUX_KERNEL_CUSTOM_TARBALL_LOCATION="$(call github,raspberrypi,linux,rpi-6.6.y)/linux-rpi-6.6.y.tar.gz"
BR2_LINUX_KERNEL_USE_DEFCONFIG=y
BR2_LINUX_KERNEL_DEFCONFIG="bcm2712"
BR2_LINUX_KERNEL_CONFIG_FRAGMENT_FILES="$(BR2_EXTERNAL_PI_TREZOR_PATH)/configs/kernel_touchscreen.fragment"
BR2_LINUX_KERNEL_DTS_SUPPORT=y
BR2_LINUX_KERNEL_INTREE_DTS_NAME="bcm2712-rpi-5-b bcm2712-rpi-cm5"

# Filesystem
BR2_TARGET_ROOTFS_EXT2=y
BR2_TARGET_ROOTFS_EXT2_4=y
BR2_TARGET_ROOTFS_EXT2_SIZE="512M"
BR2_TARGET_ROOTFS_READ_ONLY=y

# Bootloader
BR2_TARGET_RPI_FIRMWARE=y
BR2_PACKAGE_RPI_FIRMWARE=y
BR2_PACKAGE_RPI_USERLAND=y

# Init system
BR2_INIT_SYSTEMD=y
BR2_PACKAGE_SYSTEMD_NETWORKD=n
BR2_PACKAGE_SYSTEMD_RESOLVED=n

# USB support for Trezor communication
BR2_PACKAGE_LIBUSB=y
BR2_PACKAGE_LIBUDEV=y
BR2_PACKAGE_LIBHIDAPI=y

# Touchscreen support
BR2_PACKAGE_TSLIB=y
BR2_PACKAGE_INPUTATTACH=y

# Disable all networking to ensure air-gapped operation
# BR2_PACKAGE_DHCPCD is not set
# BR2_PACKAGE_IFUPDOWN_SCRIPTS is not set
# BR2_PACKAGE_WIRELESS_TOOLS is not set
# BR2_PACKAGE_WPA_SUPPLICANT is not set
# BR2_PACKAGE_OPENSSH is not set
# BR2_PACKAGE_DROPBEAR is not set
# BR2_PACKAGE_IPTABLES is not set
# BR2_LINUX_KERNEL_EXT_RTLWIFI is not set

# Disable unnecessary services
# BR2_PACKAGE_AVAHI is not set
# BR2_PACKAGE_CONNMAN is not set

# Security hardening
BR2_PACKAGE_BUSYBOX_CONFIG_FRAGMENT_FILES="$(BR2_EXTERNAL_PI_TREZOR_PATH)/configs/busybox.fragment"

# Host tools
BR2_PACKAGE_HOST_DOSFSTOOLS=y
BR2_PACKAGE_HOST_GENIMAGE=y
BR2_PACKAGE_HOST_MTOOLS=y

# Target packages for Pi-Trezor operation
BR2_PACKAGE_PYTHON3=y
BR2_PACKAGE_PYTHON3_PY_PYC=y

# Pi-Trezor specific packages
BR2_PACKAGE_TREZORD_GO=y
BR2_PACKAGE_TREZOR_FIRMWARE=y

# Go support for trezord-go
BR2_PACKAGE_HOST_GO=y

# Image generation
BR2_ROOTFS_POST_BUILD_SCRIPT="$(BR2_EXTERNAL_PI_TREZOR_PATH)/board/post_build.sh"
BR2_ROOTFS_POST_IMAGE_SCRIPT="$(BR2_EXTERNAL_PI_TREZOR_PATH)/board/post_image.sh"
BR2_ROOTFS_POST_SCRIPT_ARGS="$(BR2_EXTERNAL_PI_TREZOR_PATH)"

# Overlay for Pi-Trezor binaries and configuration
BR2_ROOTFS_OVERLAY="$(BR2_EXTERNAL_PI_TREZOR_PATH)/overlay"

# Genimage configuration
BR2_PACKAGE_HOST_GENIMAGE=y
```

## br2-external/configs/pitlab-wallet-base_defconfig
```kconfig
# PitLab Wallet Base Configuration
# Common settings for all supported boards

# System
BR2_SYSTEM_DHCP=""
BR2_TARGET_GENERIC_HOSTNAME="pitlab-wallet"
BR2_TARGET_GENERIC_ISSUE="PitLab Wallet Air-Gapped Wallet"
BR2_TARGET_GENERIC_PASSWD_SHA256=y
BR2_SYSTEM_BIN_SH_BASH=y
# BR2_TARGET_ENABLE_ROOT_LOGIN is not set
# BR2_TARGET_GENERIC_GETTY is not set
BR2_TARGET_GENERIC_REMOUNT_ROOTFS_RO=y
BR2_ENABLE_LOCALE_WHITELIST="C en_US.UTF-8"

# Common Architecture Settings
BR2_aarch64=y
BR2_ARM_FPU_VFPV4=y

# Base Packages (common across all boards)
BR2_PACKAGE_BUSYBOX_CONFIG_FRAGMENT_FILES="$(BR2_EXTERNAL_PITLAB_WALLET_PATH)/configs/busybox.fragment"
BR2_PACKAGE_LIBUSB=y
BR2_PACKAGE_LIBUDEV=y
BR2_PACKAGE_LIBHIDAPI=y
BR2_PACKAGE_TSLIB=y
BR2_PACKAGE_PYTHON3=y
BR2_PACKAGE_HOST_GO=y

# Security Settings
BR2_TOOLCHAIN_BUILDROOT_FORTIFY_SOURCE=y
BR2_SSP_REGULAR=y
BR2_RELRO_FULL=y
BR2_BINUTILS_EXTRA_CONFIG_OPTIONS="--enable-deterministic-archives"

# File System
BR2_TARGET_ROOTFS_EXT2=y
BR2_TARGET_ROOTFS_EXT2_4=y
BR2_TARGET_ROOTFS_EXT2_SIZE="256M"
BR2_ROOTFS_POST_BUILD_SCRIPT="$(BR2_EXTERNAL_PITLAB_WALLET_PATH)/board/post_build.sh"
BR2_ROOTFS_POST_IMAGE_SCRIPT="$(BR2_EXTERNAL_PITLAB_WALLET_PATH)/board/post_image.sh"

# Kernel
BR2_LINUX_KERNEL=y
BR2_LINUX_KERNEL_CUSTOM_VERSION=y
BR2_LINUX_KERNEL_CUSTOM_VERSION_VALUE="6.12.47"
BR2_LINUX_KERNEL_USE_CUSTOM_CONFIG=y
```

## br2-external/configs/pitlab-wallet-pi4_defconfig
```kconfig
# PitLab Wallet Raspberry Pi 4 Configuration (64-bit)
# Air-gapped wallet appliance with Trezor Core and trezord-go
# Target: ARM64 (aarch64)

# Base Raspberry Pi 4 64-bit configuration
BR2_aarch64=y
BR2_cortex_a72=y

# System
BR2_SYSTEM_DHCP=""
BR2_TARGET_GENERIC_HOSTNAME="pitlab-wallet"
BR2_TARGET_GENERIC_ISSUE="PitLab Wallet Air-Gapped Wallet"
BR2_TARGET_GENERIC_PASSWD_SHA256=y
BR2_SYSTEM_BIN_SH_BASH=y
# BR2_TARGET_ENABLE_ROOT_LOGIN is not set
# BR2_TARGET_GENERIC_GETTY is not set
BR2_TARGET_GENERIC_REMOUNT_ROOTFS_RO=y
BR2_ENABLE_LOCALE_WHITELIST="C en_US.UTF-8"

# Toolchain
BR2_PACKAGE_HOST_LINUX_HEADERS_CUSTOM_6_6=y
BR2_TOOLCHAIN_BUILDROOT_MUSL=y
BR2_TOOLCHAIN_BUILDROOT_CXX=y
# BR2_PIC_PIE is not set
BR2_RELRO_PARTIAL=y

# Kernel
BR2_LINUX_KERNEL=y
BR2_LINUX_KERNEL_CUSTOM_TARBALL=y
BR2_LINUX_KERNEL_CUSTOM_TARBALL_LOCATION="$(call github,raspberrypi,linux,stable_20250702)/linux-stable_20250702.tar.gz"
BR2_LINUX_KERNEL_USE_CUSTOM_CONFIG=y
BR2_LINUX_KERNEL_CUSTOM_CONFIG_FILE="$(BR2_EXTERNAL_PITLAB_WALLET_PATH)/board/linux-pi3-pi4.config"
BR2_LINUX_KERNEL_CONFIG_FRAGMENT_FILES="$(BR2_EXTERNAL_PITLAB_WALLET_PATH)/configs/kernel_touchscreen.fragment"
BR2_LINUX_KERNEL_DTS_SUPPORT=y
BR2_LINUX_KERNEL_INTREE_DTS_NAME="broadcom/bcm2711-rpi-4-b broadcom/bcm2711-rpi-400 broadcom/bcm2711-rpi-cm4 broadcom/bcm2711-rpi-cm4s"
BR2_LINUX_KERNEL_DTB_IS_SELF_BUILT=y
BR2_LINUX_KERNEL_DTB_KEEP_DIRNAME=y
# BR2_LINUX_KERNEL_INSTALL_TARGET is not set
BR2_LINUX_KERNEL_NEEDS_HOST_OPENSSL=y
BR2_LINUX_KERNEL_NEEDS_HOST_LIBELF=y
BR2_LINUX_KERNEL_NEEDS_HOST_PAHOLE=y
BR2_LINUX_KERNEL_NEEDS_HOST_PYTHON3=y
BR2_PACKAGE_LINUX_TOOLS_GPIO=y

# Filesystem
BR2_TARGET_ROOTFS_EXT2=y
BR2_TARGET_ROOTFS_EXT2_4=y
BR2_TARGET_ROOTFS_EXT2_SIZE="512M"
BR2_TARGET_ROOTFS_READ_ONLY=y

# Bootloader
BR2_TARGET_RPI_FIRMWARE=y
BR2_PACKAGE_RPI_FIRMWARE=y
BR2_PACKAGE_RPI_FIRMWARE_VARIANT_PI4=y
BR2_PACKAGE_RPI_USERLAND=y
BR2_PACKAGE_RPI_FBCP=y
BR2_PACKAGE_RASPI_GPIO=y

# Init system - BusyBox init
BR2_INIT_BUSYBOX=y

# Device management (eudev provides libudev)
BR2_ROOTFS_DEVICE_CREATION_DYNAMIC_EUDEV=y

# USB support for Trezor communication
BR2_PACKAGE_LIBUSB=y
BR2_PACKAGE_EUDEV=y
BR2_PACKAGE_HIDAPI=y

# Touchscreen support
BR2_PACKAGE_TSLIB=y
BR2_PACKAGE_INPUTATTACH=y
BR2_PACKAGE_EVTEST=y
BR2_PACKAGE_SPI_TOOLS=y

# Network management (minimal for local use)
# BR2_PACKAGE_DROPBEAR is not set
# BR2_PACKAGE_DROPBEAR_DISABLE_REVERSEDNS is not set
BR2_PACKAGE_IPTABLES=y
BR2_PACKAGE_IPTABLES_NFTABLES=y
BR2_PACKAGE_IPTABLES_NFTABLES_DEFAULT=y
# BR2_PACKAGE_NTP is not set
# BR2_PACKAGE_NTP_NTPDATE is not set

# Disable external networking to ensure air-gapped operation
# BR2_PACKAGE_DHCPCD is not set
# BR2_PACKAGE_IFUPDOWN_SCRIPTS is not set
# BR2_PACKAGE_WIRELESS_TOOLS is not set
# BR2_PACKAGE_WPA_SUPPLICANT is not set
# BR2_PACKAGE_OPENSSH is not set
# BR2_LINUX_KERNEL_EXT_RTLWIFI is not set

# Disable unnecessary services
# BR2_PACKAGE_AVAHI is not set
# BR2_PACKAGE_CONNMAN is not set

# Security hardening
BR2_TOOLCHAIN_BUILDROOT_SSP=y
BR2_SSP_STRONG=y
BR2_TOOLCHAIN_BUILDROOT_FORTIFY_SOURCE=y
BR2_TOOLCHAIN_BUILDROOT_RELRO_PARTIAL=y
BR2_PACKAGE_BUSYBOX_CONFIG_FRAGMENT_FILES="$(BR2_EXTERNAL_PITLAB_WALLET_PATH)/configs/busybox.fragment"

# Host tools
BR2_PACKAGE_HOST_CMAKE=y
BR2_PACKAGE_HOST_DOS2UNIX=y
BR2_PACKAGE_HOST_DOSFSTOOLS=y
BR2_PACKAGE_HOST_DTC=y
BR2_PACKAGE_HOST_GO=y
BR2_PACKAGE_HOST_GENIMAGE=y
BR2_PACKAGE_HOST_ISL=y
BR2_PACKAGE_HOST_KMOD_GZ=y
BR2_PACKAGE_HOST_KMOD_ZSTD=y
BR2_PACKAGE_HOST_KMOD_XZ=y
BR2_PACKAGE_HOST_MESON_TOOLS=y
BR2_PACKAGE_HOST_MTOOLS=y
BR2_PACKAGE_HOST_PKGCONF=y
BR2_PACKAGE_HOST_PYTHON3_XZ=y
BR2_PACKAGE_HOST_ZIP=y
BR2_PACKAGE_HOST_ZSTD=y

# Graphics and display support
BR2_PACKAGE_SDL2=y
BR2_PACKAGE_SDL2_IMAGE=y
BR2_PACKAGE_SDL2_TTF=y

# Target packages for PitLab Wallet operation
BR2_PACKAGE_PYTHON3=y
BR2_PACKAGE_PYTHON3_PY_PYC=y
BR2_PACKAGE_PYTHON3_BZIP2=y
BR2_PACKAGE_PYTHON3_CURSES=y
BR2_PACKAGE_PYTHON3_DECIMAL=y
BR2_PACKAGE_PYTHON3_READLINE=y
BR2_PACKAGE_PYTHON3_SQLITE=y
BR2_PACKAGE_PYTHON_PROTOBUF=y

# Compression libraries
BR2_PACKAGE_LIBARCHIVE=y
BR2_PACKAGE_LIBDEFLATE=y
BR2_PACKAGE_LZ4=y
BR2_PACKAGE_LZ4_PROGS=y
BR2_PACKAGE_LZO=y

# Crypto libraries
BR2_PACKAGE_CA_CERTIFICATES=y
# BR2_PACKAGE_CRYPTODEV_LINUX is not set
BR2_PACKAGE_LIBGCRYPT=y
BR2_PACKAGE_LIBSODIUM=y
BR2_PACKAGE_MBEDTLS=y
BR2_PACKAGE_LIBOPENSSL_BIN=y
BR2_PACKAGE_LIBOPENSSL_ENGINES=y
BR2_PACKAGE_RHASH=y

# Database libraries
BR2_PACKAGE_LMDB=y
BR2_PACKAGE_SQLITE_STAT4=y
BR2_PACKAGE_SQLITE_ENABLE_COLUMN_METADATA=y
BR2_PACKAGE_SQLITE_ENABLE_FTS3=y

# Configuration and data format libraries
BR2_PACKAGE_LIBCONFIG=y
BR2_PACKAGE_JANSSON=y
BR2_PACKAGE_LIBXML2=y
BR2_PACKAGE_LIBYAML=y
BR2_PACKAGE_RAPIDJSON=y
BR2_PACKAGE_YAML_CPP=y

# Graphics and font libraries
BR2_PACKAGE_FONTCONFIG=y
BR2_PACKAGE_HARFBUZZ=y
BR2_PACKAGE_JPEG=y
BR2_PACKAGE_JPEG_TURBO_TOOLS=y
BR2_PACKAGE_LIBFM_EXTRA=y
BR2_PACKAGE_LIBPNG=y

# Hardware interface libraries
BR2_PACKAGE_BCM2835=y
BR2_PACKAGE_MRAA=y

# Logging libraries
BR2_PACKAGE_SPDLOG=y

# Network libraries (for local use only, no external network)
BR2_PACKAGE_LIBCURL=y
BR2_PACKAGE_LIBNET=y

# Security libraries
BR2_PACKAGE_SAFECLIB=y

# System utilities
BR2_PACKAGE_BC=y
BR2_PACKAGE_HAVEGED=y
BR2_PACKAGE_FILE=y
BR2_PACKAGE_TMUX=y
BR2_PACKAGE_XXHASH=y
BR2_PACKAGE_HTOP=y
BR2_PACKAGE_PROCS=y
BR2_PACKAGE_WATCHDOG=y
BR2_PACKAGE_MKSH=y

# Libraries required by system components
BR2_PACKAGE_ZLIB=y

# PitLab Wallet specific packages
BR2_PACKAGE_TREZORD_GO=y
BR2_PACKAGE_TREZOR_EMU=y

# Image generation
BR2_ROOTFS_POST_BUILD_SCRIPT="$(BR2_EXTERNAL_PITLAB_WALLET_PATH)/board/post_build.sh"
BR2_ROOTFS_POST_IMAGE_SCRIPT="$(BR2_EXTERNAL_PITLAB_WALLET_PATH)/board/post_image.sh"
BR2_ROOTFS_POST_SCRIPT_ARGS="$(BR2_EXTERNAL_PITLAB_WALLET_PATH)"

# Overlay for PitLab Wallet binaries and configuration
BR2_ROOTFS_OVERLAY="$(BR2_EXTERNAL_PITLAB_WALLET_PATH)/../overlay"

# Download optimization and mirrors
BR2_MIRRORS="https://mirrors.kernel.org/gnu/ https://ftpmirror.gnu.org/ https://mirror.leaseweb.com/gnu/"
BR2_PRIMARY_SITE="https://sources.buildroot.net"
BR2_CCACHE=y
BR2_ENABLE_LOCALE_PURGE=y
```

## br2-external/package/rpi-fbcp/Config.in
```kconfig
config BR2_PACKAGE_RPI_FBCP
	bool "rpi-fbcp"
	depends on BR2_PACKAGE_RPI_USERLAND
	help
	  Raspberry Pi Framebuffer Copy utility for copying the primary
	  framebuffer to a secondary framebuffer device (e.g., SPI displays).

	  This is useful for displaying the main framebuffer output on
	  small SPI/GPIO-connected displays.

	  https://github.com/tasanakorn/rpi-fbcp

comment "rpi-fbcp needs rpi-userland"
	depends on !BR2_PACKAGE_RPI_USERLAND
```

## br2-external/package/trezor-emu/Config.in
```kconfig
config BR2_PACKAGE_TREZOR_EMU
	bool "Trezor Core Emulator"
	help
	  Trezor Core Emulator for air-gapped wallet operation.
	  Installs the trezor-emu binary and systemd service.
```

## br2-external/package/trezor-firmware/Config.in
```kconfig
config BR2_PACKAGE_TREZOR_FIRMWARE
	bool "trezor-firmware"
	depends on BR2_PACKAGE_PYTHON3
	select BR2_PACKAGE_PYTHON3_PY_PYC
	help
	  Trezor Core emulator for hardware wallet functionality.
	  
	  This provides the Trezor firmware emulator that runs
	  natively on Linux systems, providing full hardware wallet
	  capabilities with touchscreen support.
	  
	  https://github.com/trezor/trezor-firmware

comment "trezor-firmware needs Python 3"
	depends on !BR2_PACKAGE_PYTHON3
```

## br2-external/package/trezord-go/Config.in
```kconfig
config BR2_PACKAGE_TREZORD_GO
	bool "trezord-go"
	depends on BR2_PACKAGE_HOST_GO_TARGET_ARCH_SUPPORTS
	depends on BR2_PACKAGE_HOST_GO_TARGET_CGO_LINKING_SUPPORTS
	select BR2_PACKAGE_LIBUSB
	select BR2_PACKAGE_LIBUDEV
	select BR2_PACKAGE_LIBHIDAPI
	help
	  Trezor Bridge daemon written in Go.
	  
	  This provides USB communication between Trezor devices
	  and web applications (like Trezor Suite).
	  
	  https://github.com/trezor/trezord-go

comment "trezord-go needs a toolchain with cgo support"
	depends on !BR2_PACKAGE_HOST_GO_TARGET_CGO_LINKING_SUPPORTS
```
