/dts-v1/;
/plugin/;

/ {
    compatible = "brcm,bcm2712";

    fragment@0 {
        target-path = "/";
        __overlay__ {
            display_rotate_pi5: display-rotate {
                compatible = "pitlab,display-rotate-pi5";
                status = "okay";
                rotation = <0>;  // Default to 0, will be overridden by dtparam
                
                // Pi5-specific display parameters
                dma-ranges = <0x0 0xc0000000 0x40000000>;
                interrupt-parent = <&gicv2>;
                interrupts = <0 120 4>;
                clocks = <&clk_pll 5>;
                clock-names = "core";
            };
        };
    };
};